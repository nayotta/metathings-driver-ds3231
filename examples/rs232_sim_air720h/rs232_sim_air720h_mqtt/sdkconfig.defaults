## examples/rs232_sim_air720h/rs232_sim_air720h_mqtt/sdkconfig.defaults
```kconfig
# mutex give by all task
CONFIG_FREERTOS_CHECK_MUTEX_GIVEN_BY_OWNER=n

# ethernet
CONFIG_ETH_PHY_USE_RST=n
CONFIG_ETH_RMII_CLK_OUTPUT=y
CONFIG_ETH_RMII_CLK_OUTPUT_GPIO0=y
CONFIG_ETH_SMI_MDC_GPIO=23
CONFIG_ETH_SMI_MDIO_GPIO=18

# OTA use ssl without check
CONFIG_OTA_ALLOW_HTTP=y

# flash and partitions
CONFIG_ESPTOOLPY_FLASHSIZE_4MB=y
CONFIG_PARTITION_TABLE_CUSTOM=y
CONFIG_PARTITION_TABLE_CUSTOM_FILENAME="../../../partitions/partitions.csv"
CONFIG_PARTITION_TABLE_FILENAME="../../../partitions/partitions.csv"
```
